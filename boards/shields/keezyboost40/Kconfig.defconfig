## boards/shields/keezyboost40/Kconfig.defconfig
```kconfig
if SHIELD_KEEZYBOOST40

config ZMK_KEYBOARD_NAME
    default "keezyboost40"

config SPI
    default y

endif
```

## boards/shields/st7735r/Kconfig.defconfig
```kconfig
if SHIELD_ST7735R_160x128

select ST7735R

if ZMK_DISPLAY

config ST7735R_CMD_DATA_PIN
    int "Command/Data GPIO Pin"
    default 16
    help
        GPIO pin for the Command/Data line of the ST7735R display.

config ST7735R_RESET_PIN
    int "Reset GPIO Pin"
    default 14
    help
        GPIO pin for the Reset line of the ST7735R display.

config ST7735R_CS_PIN
    int "Chip Select GPIO Pin"
    default 17
    help
        GPIO pin for the Chip Select line of the ST7735R display.

config ST7735R_WIDTH
    int "Display Width (Pixels)"
    default 160

config ST7735R_HEIGHT
    int "Display Height (Pixels)"
    default 128

endif # ZMK_DISPLAY

endif # SHIELD_ST7735R_160x128
```

## boards/shields/st7735r/Kconfig.shield
```kconfig
config SHIELD_ST7735R_160x128
    def_bool $(shields_list_contains,st7735r_160x128)
```

## config/west.yml
```yaml
manifest:
  remotes:
    - name: zmkfirmware
      url-base: https://github.com/zmkfirmware
    - name: dhruvinsh
      url-base: https://github.com/dhruvinsh
    - name: mccheesy
      url-base: https://github.com/mccheesy
  projects:
    - name: zmk
      remote: zmkfirmware
      revision: main
      import: app/west.yml
    - name: zmk-tri-state
      remote: dhruvinsh
      revision: main
    - name: zmk-vfx-gem-status
      remote: mccheesy
      revision: main
  self:
    path: config
```
